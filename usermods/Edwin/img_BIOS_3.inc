// Generated from C:\Projects\WLED\usermods\Edwin\BIOS_3.bmp

#pragma once

#include "Image.h"

static const uint32_t img_BIOS_3_data[] = {
/* 0 */	RGBW32(127,127,127,0), RGBW32(127,127,127,0), RGBW32(0,0,0,0), RGBW32(127,127,127,0), RGBW32(127,127,127,0), RGBW32(127,127,127,0), RGBW32(0,0,0,0), RGBW32(0,0,0,0),
/* 1 */	RGBW32(0,0,0,0), RGBW32(0,0,0,0), RGBW32(0,0,0,0), RGBW32(0,0,0,0), RGBW32(0,0,0,0), RGBW32(0,0,0,0), RGBW32(0,0,0,0), RGBW32(0,0,0,0),
/* 2 */	RGBW32(0,0,0,0), RGBW32(0,0,0,0), RGBW32(0,0,0,0), RGBW32(0,0,0,0), RGBW32(0,0,0,0), RGBW32(0,0,0,0), RGBW32(0,0,0,0), RGBW32(0,0,0,0),
/* 3 */	RGBW32(0,0,0,0), RGBW32(0,0,0,0), RGBW32(0,0,0,0), RGBW32(0,0,0,0), RGBW32(0,0,0,0), RGBW32(0,0,0,0), RGBW32(0,0,0,0), RGBW32(0,0,0,0),
/* 4 */	RGBW32(0,0,0,0), RGBW32(0,0,0,0), RGBW32(0,0,0,0), RGBW32(0,0,0,0), RGBW32(0,0,0,0), RGBW32(0,0,0,0), RGBW32(0,0,0,0), RGBW32(0,0,0,0),
/* 5 */	RGBW32(0,0,0,0), RGBW32(0,0,0,0), RGBW32(0,0,0,0), RGBW32(0,0,0,0), RGBW32(0,0,0,0), RGBW32(0,0,0,0), RGBW32(0,0,0,0), RGBW32(0,0,0,0),
/* 6 */	RGBW32(0,0,0,0), RGBW32(0,0,0,0), RGBW32(0,0,0,0), RGBW32(0,0,0,0), RGBW32(0,0,0,0), RGBW32(0,0,0,0), RGBW32(0,0,0,0), RGBW32(0,0,0,0),
/* 7 */	RGBW32(0,0,0,0), RGBW32(0,0,0,0), RGBW32(0,0,0,0), RGBW32(0,0,0,0), RGBW32(0,0,0,0), RGBW32(0,0,0,0), RGBW32(0,0,0,0), RGBW32(0,0,0,0)
};

static const Image img_BIOS_3 = Image(8, 8, img_BIOS_3_data); 
