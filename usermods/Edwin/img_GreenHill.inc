// Generated from C:\Projects\WLED\usermods\Edwin\GreenHill.bmp

#pragma once

#include "Image.h"

static const uint32_t img_GreenHill_data[] = {
/* 0 */	RGBW32(0,128,128,0), RGBW32(255,255,255,0), RGBW32(255,255,255,0), RGBW32(0,128,128,0), RGBW32(0,128,128,0), RGBW32(0,128,128,0), RGBW32(0,128,128,0), RGBW32(0,128,128,0),
/* 1 */	RGBW32(0,128,128,0), RGBW32(0,128,128,0), RGBW32(0,128,128,0), RGBW32(0,128,128,0), RGBW32(0,128,128,0), RGBW32(255,255,255,0), RGBW32(255,255,255,0), RGBW32(0,128,128,0),
/* 2 */	RGBW32(0,128,128,0), RGBW32(0,128,128,0), RGBW32(0,128,128,0), RGBW32(0,128,128,0), RGBW32(0,128,128,0), RGBW32(0,128,128,0), RGBW32(0,128,128,0), RGBW32(255,255,255,0),
/* 3 */	RGBW32(0,128,128,0), RGBW32(0,128,0,0), RGBW32(0,128,0,0), RGBW32(0,128,128,0), RGBW32(0,128,128,0), RGBW32(0,128,128,0), RGBW32(0,128,128,0), RGBW32(0,128,128,0),
/* 4 */	RGBW32(0,128,0,0), RGBW32(0,128,0,0), RGBW32(0,128,0,0), RGBW32(0,128,0,0), RGBW32(0,128,0,0), RGBW32(0,128,0,0), RGBW32(0,128,128,0), RGBW32(0,128,128,0),
/* 5 */	RGBW32(0,128,0,0), RGBW32(0,128,0,0), RGBW32(0,128,0,0), RGBW32(0,128,0,0), RGBW32(0,128,0,0), RGBW32(0,128,0,0), RGBW32(0,128,0,0), RGBW32(0,128,0,0),
/* 6 */	RGBW32(0,128,0,0), RGBW32(0,128,0,0), RGBW32(0,128,0,0), RGBW32(0,128,0,0), RGBW32(0,128,0,0), RGBW32(0,128,0,0), RGBW32(0,128,0,0), RGBW32(0,128,0,0),
/* 7 */	RGBW32(0,128,0,0), RGBW32(0,128,0,0), RGBW32(0,128,0,0), RGBW32(0,128,0,0), RGBW32(0,128,0,0), RGBW32(0,128,0,0), RGBW32(0,128,0,0), RGBW32(0,128,0,0)
};

static const Image img_GreenHill = Image(8, 8, img_GreenHill_data); 
