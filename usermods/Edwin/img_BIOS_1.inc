// Generated from C:\Projects\WLED\usermods\Edwin\BIOS_1.bmp

#pragma once

#include "Image.h"

static const uint32_t img_BIOS_1_data[] = {
/* 0 */	RGBW32(0,0,255,0), RGBW32(0,0,0,0), RGBW32(127,127,127,0), RGBW32(127,127,127,0), RGBW32(0,0,0,0), RGBW32(0,0,0,0), RGBW32(127,127,127,0), RGBW32(127,127,127,0),
/* 1 */	RGBW32(0,0,0,0), RGBW32(0,0,0,0), RGBW32(0,0,0,0), RGBW32(0,0,0,0), RGBW32(0,0,0,0), RGBW32(0,0,0,0), RGBW32(127,127,127,0), RGBW32(127,127,127,0),
/* 2 */	RGBW32(127,127,127,0), RGBW32(127,127,127,0), RGBW32(127,127,127,0), RGBW32(0,0,0,0), RGBW32(127,127,127,0), RGBW32(0,0,0,0), RGBW32(0,0,0,0), RGBW32(0,0,0,0),
/* 3 */	RGBW32(0,0,0,0), RGBW32(0,0,0,0), RGBW32(0,0,0,0), RGBW32(0,0,0,0), RGBW32(0,0,0,0), RGBW32(0,0,0,0), RGBW32(0,0,0,0), RGBW32(0,0,0,0),
/* 4 */	RGBW32(0,0,0,0), RGBW32(127,127,127,0), RGBW32(127,127,127,0), RGBW32(0,0,0,0), RGBW32(0,0,0,0), RGBW32(127,127,127,0), RGBW32(0,0,0,0), RGBW32(0,0,0,0),
/* 5 */	RGBW32(0,0,0,0), RGBW32(127,127,127,0), RGBW32(127,127,127,0), RGBW32(0,0,0,0), RGBW32(0,0,0,0), RGBW32(127,127,127,0), RGBW32(0,0,0,0), RGBW32(0,0,0,0),
/* 6 */	RGBW32(0,0,0,0), RGBW32(0,0,0,0), RGBW32(0,0,0,0), RGBW32(0,0,0,0), RGBW32(0,0,0,0), RGBW32(0,0,0,0), RGBW32(0,0,0,0), RGBW32(0,0,0,0),
/* 7 */	RGBW32(127,127,127,0), RGBW32(255,255,255,0), RGBW32(0,0,0,0), RGBW32(127,127,127,0), RGBW32(127,127,127,0), RGBW32(127,127,127,0), RGBW32(0,0,0,0), RGBW32(127,127,127,0)
};

static const Image img_BIOS_1 = Image(8, 8, img_BIOS_1_data); 
