// Generated from C:\Projects\WLED\usermods\Edwin\OSBoot.bmp

#pragma once

#include "Image.h"

static const uint32_t img_OSBoot_data[] = {
/* 0 */	RGBW32(0,0,0,0), RGBW32(0,0,0,0), RGBW32(0,0,0,0), RGBW32(0,0,0,0), RGBW32(0,0,0,0), RGBW32(0,0,0,0), RGBW32(0,0,0,0), RGBW32(0,0,0,0),
/* 1 */	RGBW32(0,0,0,0), RGBW32(0,0,0,0), RGBW32(237,28,36,0), RGBW32(237,28,36,0), RGBW32(34,177,76,0), RGBW32(34,177,76,0), RGBW32(0,0,0,0), RGBW32(0,0,0,0),
/* 2 */	RGBW32(0,0,0,0), RGBW32(0,0,0,0), RGBW32(237,28,36,0), RGBW32(237,28,36,0), RGBW32(34,177,76,0), RGBW32(34,177,76,0), RGBW32(0,0,0,0), RGBW32(0,0,0,0),
/* 3 */	RGBW32(0,0,0,0), RGBW32(0,0,0,0), RGBW32(63,72,204,0), RGBW32(63,72,204,0), RGBW32(255,242,0,0), RGBW32(255,242,0,0), RGBW32(0,0,0,0), RGBW32(0,0,0,0),
/* 4 */	RGBW32(0,0,0,0), RGBW32(0,0,0,0), RGBW32(63,72,204,0), RGBW32(63,72,204,0), RGBW32(255,242,0,0), RGBW32(255,242,0,0), RGBW32(0,0,0,0), RGBW32(0,0,0,0),
/* 5 */	RGBW32(0,0,0,0), RGBW32(0,0,0,0), RGBW32(0,0,0,0), RGBW32(0,0,0,0), RGBW32(0,0,0,0), RGBW32(0,0,0,0), RGBW32(0,0,0,0), RGBW32(0,0,0,0),
/* 6 */	RGBW32(0,0,0,0), RGBW32(0,0,0,0), RGBW32(0,0,0,0), RGBW32(0,0,0,0), RGBW32(0,0,0,0), RGBW32(0,0,0,0), RGBW32(0,0,0,0), RGBW32(0,0,0,0),
/* 7 */	RGBW32(82,82,82,0), RGBW32(127,127,127,0), RGBW32(195,195,195,0), RGBW32(195,195,195,0), RGBW32(195,195,195,0), RGBW32(127,127,127,0), RGBW32(82,82,82,0), RGBW32(69,69,69,0)
};

static const Image img_OSBoot = Image(8, 8, img_OSBoot_data); 
