// Generated from C:\Projects\WLED\usermods\Edwin\BSOD.bmp

#pragma once

#include "Image.h"

static const uint32_t img_BSOD_data[] = {
/* 0 */	RGBW32(0,0,255,0), RGBW32(0,0,255,0), RGBW32(0,0,255,0), RGBW32(0,0,255,0), RGBW32(0,0,255,0), RGBW32(0,0,255,0), RGBW32(0,0,255,0), RGBW32(0,0,255,0),
/* 1 */	RGBW32(0,0,255,0), RGBW32(0,0,255,0), RGBW32(0,0,255,0), RGBW32(255,255,255,0), RGBW32(255,255,255,0), RGBW32(0,0,255,0), RGBW32(0,0,255,0), RGBW32(0,0,255,0),
/* 2 */	RGBW32(0,0,255,0), RGBW32(0,0,255,0), RGBW32(0,0,255,0), RGBW32(0,0,255,0), RGBW32(0,0,255,0), RGBW32(0,0,255,0), RGBW32(0,0,255,0), RGBW32(0,0,255,0),
/* 3 */	RGBW32(0,0,255,0), RGBW32(255,255,255,0), RGBW32(0,0,255,0), RGBW32(255,255,255,0), RGBW32(0,0,255,0), RGBW32(255,255,255,0), RGBW32(255,255,255,0), RGBW32(0,0,255,0),
/* 4 */	RGBW32(0,0,255,0), RGBW32(0,0,255,0), RGBW32(0,0,255,0), RGBW32(0,0,255,0), RGBW32(0,0,255,0), RGBW32(0,0,255,0), RGBW32(0,0,255,0), RGBW32(0,0,255,0),
/* 5 */	RGBW32(0,0,255,0), RGBW32(255,255,255,0), RGBW32(255,255,255,0), RGBW32(0,0,255,0), RGBW32(255,255,255,0), RGBW32(255,255,255,0), RGBW32(0,0,255,0), RGBW32(0,0,255,0),
/* 6 */	RGBW32(0,0,255,0), RGBW32(0,0,255,0), RGBW32(0,0,255,0), RGBW32(0,0,255,0), RGBW32(0,0,255,0), RGBW32(0,0,255,0), RGBW32(0,0,255,0), RGBW32(0,0,255,0),
/* 7 */	RGBW32(0,0,255,0), RGBW32(0,0,255,0), RGBW32(0,0,255,0), RGBW32(0,0,255,0), RGBW32(0,0,255,0), RGBW32(0,0,255,0), RGBW32(0,0,255,0), RGBW32(0,0,255,0)
};

static const Image img_BSOD = Image(8, 8, img_BSOD_data); 
