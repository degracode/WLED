// Generated from C:\Projects\WLED\usermods\Edwin\BBCNews.bmp

#pragma once

#include "Image.h"

static const uint32_t img_BBCNews_data[] = {
/* 0 */	RGBW32(0,162,232,0), RGBW32(0,162,232,0), RGBW32(0,162,232,0), RGBW32(0,162,232,0), RGBW32(0,162,232,0), RGBW32(63,72,204,0), RGBW32(63,72,204,0), RGBW32(237,28,36,0),
/* 1 */	RGBW32(237,28,36,0), RGBW32(237,28,36,0), RGBW32(237,28,36,0), RGBW32(237,28,36,0), RGBW32(237,28,36,0), RGBW32(237,28,36,0), RGBW32(237,28,36,0), RGBW32(237,28,36,0),
/* 2 */	RGBW32(255,255,255,0), RGBW32(255,255,255,0), RGBW32(255,255,255,0), RGBW32(255,255,255,0), RGBW32(255,255,255,0), RGBW32(255,255,255,0), RGBW32(255,255,255,0), RGBW32(255,255,255,0),
/* 3 */	RGBW32(255,255,255,0), RGBW32(0,0,0,0), RGBW32(255,255,255,0), RGBW32(0,0,0,0), RGBW32(255,255,255,0), RGBW32(0,162,232,0), RGBW32(0,162,232,0), RGBW32(255,255,255,0),
/* 4 */	RGBW32(255,255,255,0), RGBW32(0,0,0,0), RGBW32(255,255,255,0), RGBW32(0,0,0,0), RGBW32(255,255,255,0), RGBW32(34,177,76,0), RGBW32(34,177,76,0), RGBW32(255,255,255,0),
/* 5 */	RGBW32(255,255,255,0), RGBW32(255,255,255,0), RGBW32(0,0,0,0), RGBW32(0,0,0,0), RGBW32(255,255,255,0), RGBW32(255,255,255,0), RGBW32(255,255,255,0), RGBW32(255,255,255,0),
/* 6 */	RGBW32(255,255,255,0), RGBW32(0,0,0,0), RGBW32(0,0,0,0), RGBW32(255,255,255,0), RGBW32(0,0,0,0), RGBW32(0,0,0,0), RGBW32(255,255,255,0), RGBW32(255,255,255,0),
/* 7 */	RGBW32(127,127,127,0), RGBW32(127,127,127,0), RGBW32(195,195,195,0), RGBW32(127,127,127,0), RGBW32(127,127,127,0), RGBW32(127,127,127,0), RGBW32(195,195,195,0), RGBW32(195,195,195,0)
};

static const Image img_BBCNews = Image(8, 8, img_BBCNews_data); 
